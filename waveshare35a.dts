/dts-v1/;

/ {
	compatible = "brcm,bcm2835\0brcm,bcm2708\0brcm,bcm2709";

	fragment@0 {
		target = <0xffffffff>;

		__overlay__ {
			status = "okay";

			spidev@0 {
				status = "disabled";
			};

			spidev@1 {
				status = "disabled";
			};
		};
	};

	fragment@1 {
		target = <0xffffffff>;

		__overlay__ {

			waveshare35a_pins {
				brcm,pins = <0x11 0x19 0x18>;
				brcm,function = <0x00 0x00 0x00>;
				phandle = <0x01>;
			};
		};
	};

	fragment@2 {
		target = <0xffffffff>;

		__overlay__ {
			#address-cells = <0x01>;
			#size-cells = <0x00>;

			waveshare35a@0 {
				compatible = "ilitek,ili9486";
				reg = <0x00>;
				pinctrl-names = "default";
				pinctrl-0 = <0x01>;
				spi-max-frequency = <0xf42400>;
				txbuflen = <0x8000>;
				rotate = <0x5a>;
				bgr = <0x00>;
				fps = <0x1e>;
				buswidth = <0x08>;
				regwidth = <0x10>;
				reset-gpios = <0xffffffff 0x19 0x01>;
				dc-gpios = <0xffffffff 0x18 0x00>;
				debug = <0x00>;
				init = <0x10000b0 0x00 0x1000011 0x20000ff 0x100003a 0x55 0x1000036 0x28 0x10000c2 0x44 0x10000c5 0x00 0x00 0x00 0x00 0x10000e0 0x0f 0x1f 0x1c 0x0c 0x0f 0x08 0x48 0x98 0x37 0x0a 0x13 0x04 0x11 0x0d 0x00 0x10000e1 0x0f 0x32 0x2e 0x0b 0x0d 0x05 0x47 0x75 0x37 0x06 0x10 0x03 0x24 0x20 0x00 0x10000e2 0x0f 0x32 0x2e 0x0b 0x0d 0x05 0x47 0x75 0x37 0x06 0x10 0x03 0x24 0x20 0x00 0x1000036 0x28 0x1000011 0x1000029>;
				phandle = <0x02>;
			};

			waveshare35a-ts@1 {
				compatible = "ti,ads7846";
				reg = <0x01>;
				spi-max-frequency = <0xc350>;
				interrupts = <0x11 0x02>;
				interrupt-parent = <0xffffffff>;
				pendown-gpio = <0xffffffff 0x11 0x01>;
				ti,x-plate-ohms = [00 14];
				ti,pressure-max = [00 ff];
				phandle = <0x03>;
			};
		};
	};

	__overrides__ {
		speed = <0x02 0x7370692d 0x6d61782d 0x66726571 0x75656e63 0x793a3000>;
		txbuflen = [00 00 00 02 74 78 62 75 66 6c 65 6e 3a 30 00];
		rotate = [00 00 00 02 72 6f 74 61 74 65 3a 30 00];
		fps = [00 00 00 02 66 70 73 3a 30 00];
		bgr = [00 00 00 02 62 67 72 3a 30 00];
		debug = <0x02 0x64656275 0x673a3000>;
		swapxy = <0x03 0x74692c73 0x7761702d 0x78793f00>;
	};

	__fixups__ {
		spi0 = "/fragment@0:target:0\0/fragment@2:target:0";
		gpio = "/fragment@1:target:0\0/fragment@2/__overlay__/waveshare35a@0:reset-gpios:0\0/fragment@2/__overlay__/waveshare35a@0:dc-gpios:0\0/fragment@2/__overlay__/waveshare35a-ts@1:interrupt-parent:0\0/fragment@2/__overlay__/waveshare35a-ts@1:pendown-gpio:0";
	};

	__local_fixups__ {

		fragment@2 {

			__overlay__ {

				waveshare35a@0 {
					pinctrl-0 = <0x00>;
				};
			};
		};

		__overrides__ {
			speed = <0x00>;
			txbuflen = <0x00>;
			rotate = <0x00>;
			fps = <0x00>;
			bgr = <0x00>;
			debug = <0x00>;
			swapxy = <0x00>;
		};
	};
};
